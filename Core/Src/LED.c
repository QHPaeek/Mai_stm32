#include "LED.h"
#include "stdio.h"

#define NUM_LED 16
uint8_t RGB_data_raw[48] = {0xff}; //16LED
uint32_t RGB_data_DMA_buffer[609] = {120};

const uint8_t gamma8[256] = {
  0,   0,   0,   0,   0,   0,   0,   0,   0,   0,   0,   1,   1,   1,   1,   1,
  2,   2,   2,   2,   2,   3,   3,   3,   4,   4,   4,   5,   5,   5,   6,   6,
  6,   7,   7,   7,   8,   8,   9,   9,   9,  10,  10,  11,  11,  12,  12,  13,
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229, 231, 232, 234, 236, 237, 239, 241, 242, 244, 246, 248, 249, 251, 253, 255
};

void LED_set(uint8_t led_no,uint8_t r,uint8_t g,uint8_t b){
	if(led_no >= NUM_LED){
		return;
	}
	RGB_data_raw[led_no * 3] = r;
	RGB_data_raw[led_no * 3 + 1] = g;
	RGB_data_raw[led_no * 3 + 2] = b;
}
void LED_refresh()
{
	//pwm计数�??????120重载，设置为120即一直低电平，设置为90表示ws2812的高，设置为30表示ws2812的低
	//ws2812传输数据顺序要求是GRB,游戏下发数据为RGB,�??????要对调顺�??????
	for(uint8_t i = 0 ;i<16;i++)
	{
		for(uint8_t j = 0 ;j <8;j++)
		{
			RGB_data_DMA_buffer[(i*3)*8+j+224] = (gamma8[RGB_data_raw[i*3+1]] & (1<<j)) ? 90:30;
		}
		for(uint8_t j = 0 ;j <8;j++)
		{
			RGB_data_DMA_buffer[(i*3+1)*8+j+224] = (gamma8[RGB_data_raw[i*3]] & (1<<j)) ? 90:30;
		}
		for(uint8_t j = 0 ;j <8;j++)
		{
			RGB_data_DMA_buffer[(i*3+2)*8+j+224] = (gamma8[RGB_data_raw[i*3+2]] & (1<<j)) ? 90:30;
		}
	}
	HAL_TIM_PWM_Start_DMA(&htim2, TIM_CHANNEL_1, (uint32_t *)RGB_data_DMA_buffer, 609);
}

